## config/west.yml
```yaml
manifest:
  remotes:
    - name: SethMilliken
      url-base: https://github.com/SethMilliken
  projects:
    - name: zmk
      remote: SethMilliken
      revision: zen-display-patches
      import: app/west.yml
  self:
    path: config
```
